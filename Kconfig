## Kconfig
```kconfig
# SPDX-License-Identifier: GPL-2.0
#
# For a description of the syntax of this configuration file,
# see Documentation/kbuild/kconfig-language.txt.
#
mainmenu "Micronix/$(ARCH) $(KERNELVERSION) Kernel Configuration"

comment "Compiler: $(CC_VERSION_TEXT)"

source "scripts/Kconfig.include"

source "arch/$(SRCARCH)/Kconfig"

source "drivers/Kconfig"

menu "Kernel options"
source "kernel/Kconfig"
endmenu

source "programs/Kconfig"
```

## arch/mips/Kconfig
```kconfig
config MIPS
	bool

config 32BIT
        bool

config CPU_MIPS32_R2
        bool

config MAX_IRQS
        int 
        default 75 if ARCH_PIC32MX

config ARCH_PIC32MX
	bool "PIC32 MX architecture"
	help
          Select this option if this is for a PIC32MX
	select CPU_LITTLE_ENDIAN
        select CPU_MIPS32_R2
        select 32BIT
        select MIPS

config CPU_LITTLE_ENDIAN
	bool "Little Endian CPU"

source "arch/mips/mach-pic32mx/Kconfig"
```

## arch/mips/mach-pic32mx/Kconfig
```kconfig
if ARCH_PIC32MX

choice
	prompt "PIC32MX type"

config ARCH_PIC32MX795F512L
	bool "PIC32MX795F512L"

endchoice 

# --------------------------------------------

choice 
	prompt "PIC32MX775F512L Board Type"

config MACH_MAX32
	bool "MAX32"
	help
	  Select this if you are using Digilents MAX32

endchoice

endif
```

## drivers/Kconfig
```kconfig
menu "Device Drivers"

source "drivers/tty/Kconfig"
source "drivers/timer/Kconfig"
source "drivers/i2c/Kconfig"

endmenu
```

## drivers/i2c/Kconfig
```kconfig
config ENABLE_I2C
	bool "Enable I2C subsystem"
	help
	  Enable I2C subsystem

if ENABLE_I2C

endif
```

## drivers/timer/Kconfig
```kconfig
config PIC32_CORETIMER
    depends on ARCH_PIC32MX
    bool "Coretimer driver"
    help
      This enables the coretimer driver for the PIC32.
      Needed if you want preemptive multitasking
```

## drivers/tty/Kconfig
```kconfig
config ENABLE_TTY
	bool "Enable TTY drivers"
	help
	  Enable TTY/serial subsystem

if ENABLE_TTY
source "drivers/tty/serial/Kconfig"
endif
```

## drivers/tty/serial/Kconfig
```kconfig
config PIC32_SERIAL
	bool "PIC32 Serial Port"
	help 
	  This enables the PIC32 serial port
```

## kernel/Kconfig
```kconfig
config STATIC_KLIST
    bool "Static KList"
    help
      Select this option to use a static number of klist nodes
      This means that no dynamic memory allocation is needed

config KLIST_NODES
    int  "Number of KList nodes"
    default 200
    depends on STATIC_KLIST
    help
      The number of klist nodes to allocate on the system.
      Fewer nodes results in less memory, but a correspodingly
      less capable system

config STATIC_PROCESS_LIST
    bool "Static process list"
    help
      Select this option to use a static number of processes
      This means that no dynamic memory allocation is needed

config MAX_STATIC_PROCESSES
    int  "Maximum number of processes"
    default 10
    depends on STATIC_PROCESS_LIST
    help
      The maximum number of processes that can be running at once

config STACK_SIZE
    int "Stack size"
    default 1024
    depends on STATIC_PROCESS_LIST
    help
      The size of a stack for a process.

config ENABLE_PRINTK
    bool "Enable printk debugging"
    default y
    help
      Enable the printk call

config MAX_PROCESS_FDS
    int "Max file descriptor per process"
    default 4
    help
      Configures how many file descriptors can be open on a 
      per-process basis
```

## programs/Kconfig
```kconfig
config ENABLE_BUILTIN_PROGRAMS
    bool "Enable built-in programs"
    ---help---
      Select this option to enable built-in programs.

if ENABLE_BUILTIN_PROGRAMS

menu "Built-in programs"

source "programs/blinky_light/Kconfig"

endmenu

endif
```

## programs/blinky_light/Kconfig
```kconfig
config BLINKY_LIGHT
    bool "Blink a light"

config BLINKY_LIGHT_PIN
    int "Pin connected to LED to blink light"
    depends on BLINKY_LIGHT
```
